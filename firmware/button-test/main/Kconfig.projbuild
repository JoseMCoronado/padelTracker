## firmware/button-test/main/Kconfig.projbuild
```kconfig
menu "Arcade button test"

config BUTTON_TEST_COUNT
    int "Number of buttons under test"
    range 1 5
    default 5
    help
        Buttons 1..N are configured; the rest are ignored. Lets you bench a
        single button without rewiring the Kconfig defaults.

config BUTTON_TEST_GPIO_1
    int "Button 1 GPIO"
    default 4
    help
        Microswitch COM to GND, NO to this pin. Active low with the internal
        pull-up; no external resistor. Defaults avoid the DevKitC-1 N16R8
        flash/PSRAM pins (26-37), USB (19/20), UART0 (43/44), the strapping
        pins (0/3/45/46) and the onboard RGB LED (48).

config BUTTON_TEST_GPIO_2
    int "Button 2 GPIO"
    default 5

config BUTTON_TEST_GPIO_3
    int "Button 3 GPIO"
    default 6

config BUTTON_TEST_GPIO_4
    int "Button 4 GPIO"
    default 7

config BUTTON_TEST_GPIO_5
    int "Button 5 GPIO"
    default 15

config BUTTON_TEST_LAMP_1
    int "Lamp 1 GPIO (-1 = no lamp)"
    default 16
    help
        Drives the low-side switch of the button's 5V lamp (MOSFET gate, or
        a BJT base through 1k). Set to -1 when the lamps are wired straight
        across 5V/GND and are not under software control.

config BUTTON_TEST_LAMP_2
    int "Lamp 2 GPIO (-1 = no lamp)"
    default 17

config BUTTON_TEST_LAMP_3
    int "Lamp 3 GPIO (-1 = no lamp)"
    default 18

config BUTTON_TEST_LAMP_4
    int "Lamp 4 GPIO (-1 = no lamp)"
    default 8

config BUTTON_TEST_LAMP_5
    int "Lamp 5 GPIO (-1 = no lamp)"
    default 9

config BUTTON_TEST_LAMP_ACTIVE_HIGH
    bool "Lamps are active high"
    default y

config BUTTON_TEST_SETTLE_MS
    int "Edge burst settle window (ms)"
    range 5 200
    default 25
    help
        A run of edges is treated as one transition once the pin has been
        quiet for this long. Must sit above the real bounce time and below
        the shortest press a human can make (~50 ms).

config BUTTON_TEST_BOUNCE_WARN_MS
    int "Warn when a bounce burst reaches this many ms"
    range 1 600
    default 150
    help
        The debounce constant the product firmware assumes:
        RemoteCoreConfig::stable_press_ms and WiredButton in
        firmware/court-display, both 150 ms since ADR-0016. A warning here
        means a bounce burst can outlast the debounce, so the constant has to
        be raised before the switches are trusted. Release bounce is not the
        same hazard: a burst can only fake a press by holding contact for the
        full press threshold.

endmenu
```

## firmware/court-display/main/Kconfig.projbuild
```kconfig
menu "Padel Court"

config PADEL_COURT_ID
    int "Court id"
    range 1 255
    default 1

config PADEL_COURT_WIFI_CHANNEL
    int "Wi-Fi channel"
    range 1 13
    default 1
    help
        ESP-NOW channel. Remotes must be configured to the same channel.

config PADEL_COURT_BUZZER_GPIO
    int "Buzzer GPIO"
    default 6
    help
        Sounder pin (spec section 15). GPIO6 is the free sensor-header pin on
        the 7B — the only one the RGB panel leaves alone. Verify against
        docs/HARDWARE_PINOUT.md on bring-up day.

config PADEL_COURT_BUZZER_PASSIVE
    bool "Buzzer is passive (driven with LEDC tones)"
    default y
    help
        A passive element has no oscillator of its own, so the firmware
        supplies the frequency and each cue gets its own pitch shape
        (ADR-0018). Turn this off for an active buzzer, which sounds at its
        own fixed pitch when the pin is driven high: the cues then differ only
        by rhythm, which is the fallback if the passive one is too quiet in
        the hall.

config PADEL_COURT_IDLE_DIM_MIN
    int "Idle minutes before the backlight dims"
    range 0 240
    default 10
    help
        Minutes without any input (touch, wired button, remote point or pair
        request) before the panel drops to the dim level below. 0 disables
        idle dimming entirely.

config PADEL_COURT_IDLE_DIM_PERCENT
    int "Idle dim backlight percent"
    range 0 100
    default 15
    help
        Backlight level held while idle. Never brighter than the organizer's
        own brightness setting. 0 disables idle dimming entirely.

config PADEL_COURT_IDLE_OFF_MIN
    int "Idle minutes before the backlight turns off"
    range 0 720
    default 30
    help
        Second stage: minutes of idle time before the backlight is cut
        completely (EXIO2 low). 0 keeps the panel at the dim level forever.
        The first touch afterwards only wakes the display; it never scores.

config PADEL_COURT_BUTTON_A_GPIO
    int "Wired backup button GPIO (Team A)"
    default 13
    help
        Arcade button, active low with internal pull-up. GPIO13 is a TF card
        pin; this firmware keeps its journal on internal-flash LittleFS and
        never touches the card, so 11/12/13 are free.

        Do not use GPIO16 here: it is RS485_RXD, wired to the *output* of the
        7B's onboard SP3485 transceiver, so a button pulling it low fights a
        driven pin.

config PADEL_COURT_BUTTON_B_GPIO
    int "Wired backup button GPIO (Team B)"
    default 15
    help
        GPIO15 is RS485_TXD, which feeds the transceiver's high-impedance
        input, so it is safe to repurpose while RS485 is unused.

endmenu
```

## firmware/espnow-linktest/main/Kconfig.projbuild
```kconfig
menu "ESP-NOW linktest configuration"

    choice LINKTEST_ROLE
        prompt "Role"
        default LINKTEST_ROLE_SENDER
        help
            Sender plays the remote (builds POINT_INTENT packets, retries
            until a terminal ACK). Receiver plays the court (parse, dedup,
            reply ACK, count applied points).

        config LINKTEST_ROLE_SENDER
            bool "Sender (plays remote)"
        config LINKTEST_ROLE_RECEIVER
            bool "Receiver (plays court)"
    endchoice

    config LINKTEST_WIFI_CHANNEL
        int "Wi-Fi channel"
        range 1 13
        default 6

    config LINKTEST_COURT_ID
        int "Court id carried in packets"
        range 0 65535
        default 1

    config LINKTEST_REMOTE_ID
        int "Remote id (sender)"
        default 161

    config LINKTEST_TEAM
        int "Team the sender presses for (1 = A, 2 = B)"
        range 1 2
        default 1

    config LINKTEST_BURST_COUNT
        int "Scripted burst press count (sender)"
        default 500

    config LINKTEST_BURST_GAP_MS
        int "Gap between scripted presses in ms (sender)"
        default 40

    config LINKTEST_ACK_DROP_PCT
        int "Percent of ACKs deliberately dropped (receiver, forces retries)"
        range 0 90
        default 20

endmenu
```

## firmware/remote/main/Kconfig.projbuild
```kconfig
menu "Padel Remote"

config PADEL_REMOTE_WIFI_CHANNEL
    int "Wi-Fi channel"
    range 1 13
    default 1
    help
        ESP-NOW channel. Must match the court until channel handover via
        PAIR_ASSIGN is exercised on hardware.

config PADEL_REMOTE_BUTTON_GPIO
    int "Point button GPIO"
    default 3
    help
        Active-low button input with internal pull-up. Default GPIO3 = pad
        D1 on the XIAO ESP32-C3. Verify against docs/HARDWARE_PINOUT.md on
        bring-up day.

config PADEL_REMOTE_PRESS_MS
    int "Press debounce / minimum press (ms)"
    range 30 600
    default 150
    help
        How long the button must stay down before the press counts. The
        default 150 ms rejects the accidental brushes players produce with a
        shirt or a racket while still feeling instant on a deliberate press.
        Raise it if a court still records phantom points; the undo hold
        (1500 ms) puts the ceiling on how far this can go.

config PADEL_REMOTE_LED_GPIO
    int "Feedback LED GPIO"
    default 10
    help
        External feedback LED (the XIAO ESP32-C3 has no user LED on board).
        Default GPIO10 = pad D10. Active high.

config PADEL_REMOTE_SLEEP_ENABLE
    bool "Deep sleep after inactivity"
    default y
    help
        Deep sleep once remote_core reports nothing outstanding for
        PADEL_REMOTE_SLEEP_TIMEOUT_S, waking on the point button (spec 11.4
        step 3). Requires the button to sit on GPIO0-5, the only pins that
        can wake an ESP32-C3 from deep sleep. Turn this off for bench work:
        a sleeping remote drops off the serial monitor.

config PADEL_REMOTE_SLEEP_TIMEOUT_S
    int "Inactivity timeout before deep sleep (seconds)"
    depends on PADEL_REMOTE_SLEEP_ENABLE
    range 5 86400
    default 900
    help
        Idle time before the remote sleeps. The default 15 minutes is far
        longer than any gap between points, so it only triggers between
        sessions. Shorten it to exercise sleep/wake cycles on the bench.

endmenu
```
